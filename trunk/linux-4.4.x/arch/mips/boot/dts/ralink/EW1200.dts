/dts-v1/;

#include "mt7621.dtsi"
#include <dt-bindings/input/input.h>
#include "mt7621-spi-16m-layout.dtsi"
#include "mt7621-raeth-gmac2.dtsi"
#include "mt7621-pinctrl-default-gpio.dtsi"

/ {
   compatible = "mediatek,mt7621-soc";
   model = "EW1200";
  
   	chosen {
   		bootargs = "console=ttyS0,115200";
    	};

	leds {
		compatible = "gpio-leds";
    
		usb {
			label = "usb";
			gpios = <&gpio0 4 GPIO_ACTIVE_LOW>;
			linux,default-trigger = "usbport";
		};
	};

&xhci {
	     status = "okay";
};

&u3phy1 {
	     status = "okay";
};
